/*
 * Copyright (c) 2020 Pete Johanson
 *
 * SPDX-License-Identifier: MIT
 */

#include "corne36.dtsi"

&kscan0 {
	compatible = "zmk,kscan-blackout";
	label = "KSCAN";
	/delete-property/ wakeup-source;
	/delete-property/ diode-direction;
	/delete-property/ row-gpios;
	/delete-property/ col-gpios;
};

#include "corne36_zplit.dtsi"
