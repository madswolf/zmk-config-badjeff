## config/boards/shields/corne36/Kconfig.defconfig
```kconfig
if SHIELD_CORNE36_DONGLE

config ZMK_KEYBOARD_NAME
    default "corne36"

config ZMK_SPLIT_ROLE_CENTRAL
    default y

endif

if SHIELD_CORNE36_DONGLE

config ZMK_SPLIT
    default y

endif

if SHIELD_CORNE36_TPOINT0

config ZMK_SPLIT
    default y

endif
```

## config/west.yml
```yaml
manifest:
  remotes:
    # - name: zmkfirmware
    #   url-base: https://github.com/zmkfirmware
    - name: nrfconnect
      url-base: https://github.com/nrfconnect
    - name: badjeff
      url-base: https://github.com/badjeff
  projects:
    # - name: zmk
    #   remote: zmkfirmware
    #   revision: main
    #   import: app/west.yml
    - name: zmk
      remote: badjeff
      revision: main
      import: app/west.yml
    - name: zmk-analog-input-driver
      remote: badjeff
      revision: main
    # - name: zmk-input-behavior-listener
    #   remote: badjeff
    #   revision: main
    - name: zmk-output-behavior-listener
      remote: badjeff
      revision: main
    # - name: zmk-hid-io
    #   remote: badjeff
    #   revision: main
    # - name: zmk-split-peripheral-input-relay
    #   remote: badjeff
    #   revision: main
    # - name: zmk-split-peripheral-output-relay
    #   remote: badjeff
    #   revision: main
    - name: zmk-split-peripheral-bonding-tweak
      remote: badjeff
      revision: main
    - name: zmk-kscan-blackout
      remote: badjeff
      revision: main
    - name: zmk-input-processor-report-rate-limit
      remote: badjeff
      revision: main
    - name: zmk-input-processor-xyz
      remote: badjeff
      revision: main
    - name: kb_zmk_ps2_mouse_trackpoint_driver
      remote: badjeff
      revision: main
  self:
    path: config
```
